AUTOSAR XML (schema 00046)
package /INT_PKG
  5 x sender receiver interface:
    Lidar_interface
      data Dist: type=uint32, init-value=100
    Speeed_interface
      data speed: type=uint32, init-value=0
    SPEED_REQ
      data speed_req: type=uint32, init-value=0
    DIST_REQ
      data dist_req: type=uint32, init-value=100
    Warning
      data led_command: type=uint8, init-value=0
  parameter interface DIST_PARAM_INTR
    parameter data prototype distances_{1..3}: type=uint8, init-value=100
  sender receiver interface COMPLIX_DEVICE_DRIVER_INTR
    data speed_command: type=uint16, init-value=0
  nv data interface NVB_STORGE_INTER
    nv-datas:
      data storage: type=uint16, init-value=0
  client server interface DIGNOSTIC_INTER
    operation data_processing
      arg data: direction=IN
      arg state: direction=OUT
