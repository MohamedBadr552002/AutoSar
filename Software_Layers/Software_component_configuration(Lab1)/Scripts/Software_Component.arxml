AUTOSAR XML (schema 4.0)
package /Software_Com_pkg
  sensor actuator sw component type Lidar_data_SWC1
  sensor actuator sw component type Speed_fb_SWC2
  application sw component type EABS_SWC3
  parameter sw component type param_SWC4
  sensor actuator sw component type Led_Warinig_SWC5
  nv block sw component type Flash_NVB_SWC6
  ecu abstraction sw component type ECU_SWC6
  complex device driver sw component type CDD_SWC7
  service sw component type Dign_SWC8
