AUTOSAR XML (schema 00046)
package /INT_PKG
  sender receiver interface IN_SR_DoorLock
    data DoorState: type=uint8, init-value=0
  client server interface IN_CS_LED
    operation led_switch: possible-error=[E_OK, E_NOK]
      arg door_state: type=uint8, direction=IN
    error E_OK: error-code=0
    error E_NOK: error-code=1
